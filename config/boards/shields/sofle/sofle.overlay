// Cleaned sofle.overlay without OLED
/ {
    chosen {
        zmk,keyboard = &kscan0;
    };
};

&kscan0 {
    compatible = "zmk,kscan-gpio-matrix";
    row-gpios = < &gpio0 13 0 >, < &gpio0 14 0 >, < &gpio0 15 0 >, < &gpio1 0 0 >;
    col-gpios = < &gpio1 1 0 >, < &gpio1 2 0 >, < &gpio1 3 0 >, < &gpio1 4 0 >, < &gpio1 5 0 >;
};
