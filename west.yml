## west.yml
```yaml
manifest:
  defaults:
    remote: zmkfirmware

  remotes:
    - name: zmkfirmware
      url-base: https://github.com/zmkfirmware
    - name: zephyrproject
      url-base: https://github.com/zephyrproject-rtos

  projects:
    - name: zmk
      revision: main
      path: zmk
      import: app/west.yml

  self:
    path: config
```
